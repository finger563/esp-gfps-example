## main/Kconfig.projbuild
```kconfig
menu "Configuration"

    config DEVICE_NAME
        string "BLE Device Name"
        default "GFPS Example"
        help
            Set the BLE device name used in advertisement of the BLE device.

    config MODEL_ID
        hex "Model ID"
        default 0x11223344
        help
            Set the model id (24 bit)

    config ANTISPOOFING_PRIVATE_KEY
        string "Anti-Spoofing Private Key"
        help
            Set the anti-spoofing private key, as a base64 uncompressed string.

endmenu
```

## sdkconfig.defaults
```kconfig
# CONFIG_IDF_TARGET="esp32"
# CONFIG_IDF_TARGET="esp32s2"
# CONFIG_IDF_TARGET="esp32s3"
# CONFIG_IDF_TARGET="esp32c3"

CONFIG_FREERTOS_HZ=1000

# ESP32-specific
#
CONFIG_ESP_DEFAULT_CPU_FREQ_MHZ_240=y
CONFIG_ESP_DEFAULT_CPU_FREQ_MHZ=240

# Common ESP-related
#
CONFIG_ESP_SYSTEM_EVENT_TASK_STACK_SIZE=4096
CONFIG_ESP_MAIN_TASK_STACK_SIZE=8192

# TODO: uncomment if you want to enable exceptions (which may be needed by certain components such as cli)
# CONFIG_COMPILER_CXX_EXCEPTIONS=y

CONFIG_BT_ENABLED=y
CONFIG_BT_BLE_42_FEATURES_SUPPORTED=y
CONFIG_BT_MAX_DEVICE_NAME_LEN=128

# SPI Flash Config:
CONFIG_ESPTOOLPY_FLASHSIZE_8MB=y

# Partition Table
CONFIG_PARTITION_TABLE_CUSTOM=y
CONFIG_PARTITION_TABLE_CUSTOM_FILENAME="partitions.csv"
```
